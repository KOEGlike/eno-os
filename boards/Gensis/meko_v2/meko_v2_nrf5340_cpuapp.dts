/dts-v1/;
#include <nordic/nrf5340_cpuapp_qkaa.dtsi>
#include "meko_v2-pinctrl.dtsi"

/ {
	model = "a music player (CPUAPP)";
	compatible = "Gensis,meko-v2-cpuapp";

	chosen {
		zephyr,sram = &sram0_image;
		zephyr,flash = &flash0;
		zephyr,code-partition = &slot0_partition;
		zephyr,sram-secure-partition = &sram0_s;
		zephyr,sram-non-secure-partition = &sram0_ns;
	};
};

#include "meko_v2-cpuapp_partitioning.dtsi"
#include "meko_v2-shared_sram.dtsi"

## boards/Gensis/meko_v2/Kconfig.meko_v2
```kconfig
config BOARD_MEKO_V2
	select SOC_NRF5340_CPUAPP_QKAA if BOARD_MEKO_V2_NRF5340_CPUAPP || BOARD_MEKO_V2_NRF5340_CPUAPP_NS
	select SOC_NRF5340_CPUNET_QKAA if BOARD_MEKO_V2_NRF5340_CPUNET
```

## boards/Gensis/meko_v2/meko_v2_nrf5340_cpuapp_ns_defconfig
```kconfig
# Enable MPU
CONFIG_ARM_MPU=y

# Enable TrustZone-M
CONFIG_ARM_TRUSTZONE_M=y

# This Board implies building Non-Secure firmware
CONFIG_TRUSTED_EXECUTION_NONSECURE=y

CONFIG_I2C=y
CONFIG_I2C_SHELL=y
CONFIG_SPI=y

CONFIG_SSD16XX=y
CONFIG_AMS_AS5600=y

CONFIG_MFD_NPM13XX=y
CONFIG_LED_NPM13XX=y
```

## boards/Gensis/meko_v2/meko_v2_nrf5340_cpunet_defconfig
```kconfig
CONFIG_ARM_MPU=y
CONFIG_HW_STACK_PROTECTION=y

CONFIG_GPIO=y
CONFIG_PWM=y

CONFIG_I2C=y
CONFIG_SPI=y
```
